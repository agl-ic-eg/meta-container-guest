## conf/layer.conf
```bitbake
# We have a conf and classes directory, add to BBPATH
BBPATH =. "${LAYERDIR}:"

# We have recipes-* directories, add to BBFILES
BBFILES += "${LAYERDIR}/recipes-*/*/*.bb \
            ${LAYERDIR}/recipes-*/*/*.bbappend"

BBFILE_COLLECTIONS += "container-guest"
BBFILE_PATTERN_container-guest = "^${LAYERDIR}/"
BBFILE_PRIORITY_container-guest = "80"
LAYERSERIES_COMPAT_container-guest = "thud"
```
